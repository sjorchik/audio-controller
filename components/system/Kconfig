## components/system/Kconfig
```kconfig
menu "System Configuration"
    config APP_DEV_CONSOLE
        bool "Enable Development Console"
        default n
        help
            Увімкнути інтерактивну dev-консоль для bring-up та тестів.
            Команди: i2cscan, src <0..3>, mute <0|1>, stats
            
            Вимкнено у продакшн-збірках для економії RAM та безпеки.
endmenu
```

## components/tda7318/Kconfig
```kconfig
menu "TDA7318 selector (roadmap item 3)"
    choice APP_SELECTOR_CHIP
        prompt "Audio selector chip on board"
        default APP_SELECTOR_CHIP_TDA7318
        help
            Цільова плата за ROADMAP — TDA7318. Для тестового стенду
            допускається PT2313 (клон TDA7313): байти команд інші.
        config APP_SELECTOR_CHIP_TDA7318
            bool "TDA7318 (цільова)"
        config APP_SELECTOR_CHIP_PT2313
            bool "PT2313 / TDA7313 (стенд)"
    endchoice
endmenu
```
